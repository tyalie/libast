## Kconfig
```kconfig
# Copyright (c) 2023 Tyalie
# SPDX-License-Identifier: Apache-2.0

config ZEPHYR_LIBAST_MODULE
  bool

config LIBAST
  bool "libast math expression parser and evaluator"
  help
    This option enables the libast math expression parser and evaluator
    using ast and infix notation to solve the job.
```
